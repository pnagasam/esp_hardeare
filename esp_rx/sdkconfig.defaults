## esp_rx/sdkconfig.defaults
```kconfig
CONFIG_ESP32S3_DEFAULT_CPU_FREQ_240=y
CONFIG_ESP32_WIFI_CSI_ENABLED=y
CONFIG_ESP_WIFI_CSI_ENABLED=y
CONFIG_ESP_WIFI_AMPDU_RX_ENABLED=n

CONFIG_ESP_CONSOLE_USB_SERIAL_JTAG=y
CONFIG_ESP_CONSOLE_UART=n
CONFIG_ESP_CONSOLE_USB_SERIAL_JTAG_TX_BUF_SIZE=4096
CONFIG_ESP_CONSOLE_SECONDARY_NONE=y

CONFIG_FREERTOS_HZ=1000
```

## esp_tx/sdkconfig.defaults
```kconfig
CONFIG_ESP32S3_DEFAULT_CPU_FREQ_240=y
CONFIG_ESP_CONSOLE_USB_SERIAL_JTAG=Y
CONFIG_ESP_CONSOLE_UART=n
CONFIG_ESP_CONSOLE_USB_SERIAL_JTAG_TX_BUF_SIZE=2048
CONFIG_FREERTOS_HZ=1000
```
